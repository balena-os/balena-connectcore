## layers/meta-balena-connectcore/conf/layer.conf
```bitbake
BBPATH .= ":${LAYERDIR}"

BBFILES += "${LAYERDIR}/recipes-*/*/*.bb \
            ${LAYERDIR}/recipes-*/*/*.bbappend"

BBFILE_COLLECTIONS += "balena-connectcore"
BBFILE_PATTERN_balena-connectcore := "^${LAYERDIR}/"
BBFILE_PRIORITY_balena-connectcore = "1337"

LAYERSERIES_COMPAT_balena-connectcore = "dunfell"

PREFERRED_PROVIDER_u-boot_ccimx8x = "u-boot-dey"
PREFERRED_PROVIDER_virtual/bootloader_ccimx8x = "u-boot-dey"

ACCEPT_FSL_EULA = "1"

SERIAL_CONSOLES_ccimx8x = "115200;ttyLP2"

BBMASK += "meta-digi/meta-digi-arm/recipes-bsp/u-boot/u-boot-fw-utils_%.bbappend"

LAYERSERIES_COMPAT_digi-arm_append = " dunfell"
```
